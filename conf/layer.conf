## conf/layer.conf
```bitbake
# EULA handling (ST style)
EULA_FILE_ST:stm32mpthingscore = "${LAYERDIR}/conf/eula/${MACHINE}"
EULA_FILE_ST_MD5SUM:stm32mpthingscore = "8b505090fb679839cefbcc784afe8ce9"

# Inform bitbake of additional license locations
LICENSE_PATH += "${LAYERDIR}/files/licenses"

# STM32MP ThingsCore BSP root
STM32MP_THINGSCORE = "${LAYERDIR}"

# Layer version
LAYERVERSION_meta-st-thingscore = "1"

# Layer dependencies
LAYERDEPENDS_meta-st-thingscore = "stm-st-stm32mp-mx"

# OpenEmbedded compatibility
LAYERSERIES_COMPAT_meta-st-thingscore = "scarthgap"

# Add conf and classes to BBPATH
BBPATH .= ":${LAYERDIR}"

# Recipe locations
BBFILES += "${LAYERDIR}/recipes-*/*/*.bb \
            ${LAYERDIR}/recipes-*/*/*.bbappend"

# Layer collection info
BBFILE_COLLECTIONS += "meta-st-thingscore"
BBFILE_PATTERN_meta-st-thingscore = "^${LAYERDIR}/"
BBFILE_PRIORITY_meta-st-thingscore = "9"
```

## conf/machine/thingscore-1-mx.conf
```bitbake
#@TYPE: Machine
#@NAME: stm32mp133d-thingscore-1-mx
#@DESCRIPTION: Configuration for STM32CubeMX generated project
#@NEEDED_BSPLAYERS: layers/meta-openembedded/meta-oe layers/meta-openembedded/meta-python layers/meta-st/meta-st-stm32mp-addons layers/meta-st/meta-st-thingscore


###########################################################################
#
# Default machine configuration sections
#
###########################################################################

# Define specific common machine name
MACHINEOVERRIDES .= ":stm32mpcommonmx:stm32mp13commonmx"
MACHINEOVERRIDES .= ":stm32mp1common:stm32mp13common"

include conf/machine/include/st-machine-common-stm32mp.inc
include conf/machine/include/st-machine-providers-stm32mp.inc

# =========================================================================
# Chip architecture
# =========================================================================
DEFAULTTUNE = "cortexa7thf-neon-vfpv4"
include conf/machine/include/arm/armv7a/tune-cortexa7.inc

# =========================================================================
# boot scheme
# =========================================================================

# =========================================================================
# boot device
# =========================================================================

# =========================================================================
# Machine settings
# =========================================================================
# Enable the board device storage support with CUBEMX_DTB
STM32MP_DT_FILES_NAND      += "${CUBEMX_DTB}"
STM32MP_DT_FILES_NOR_all   += "${CUBEMX_DTB}"
STM32MP_DT_FILES_NOR_mb    += "${CUBEMX_DTB}"
STM32MP_DT_FILES_EMMC      += "${CUBEMX_DTB}"
STM32MP_DT_FILES_SDCARD    += "${CUBEMX_DTB}"
STM32MP_DT_FILES_SPINAND   += "${CUBEMX_DTB}"

# =========================================================================
# Machine features (default for stm32mp1 like)
# =========================================================================
MACHINE_FEATURES += "splashscreen"
MACHINE_FEATURES += "watchdog"
MACHINE_FEATURES += "nosmp"

# =========================================================================
# Flashlayout
# =========================================================================
# Set the FLASHLAYOUT_TYPE_LABELS for 'extensible' to CUBEMX_DTB
FLASHLAYOUT_TYPE_LABELS:extensible = "${CUBEMX_DTB}"

# =========================================================================
# CubeMX extra config
# =========================================================================
ENABLE_CUBEMX_DTB = "1"
STM32MP_DEVICETREE = "${CUBEMX_DTB}"
###########################################################################
#
# User machine customization sections
#
###########################################################################

# Boot Scheme
# =========================================================================
BOOTSCHEME_LABELS += "optee"

# Boot Device Choice
# =========================================================================
# Define the boot device supported
#BOOTDEVICE_LABELS += "sdcard"
BOOTDEVICE_LABELS += "emmc"
BOOTDEVICE_LABELS += "nand-2-128-256"

# Support Feature Choice
# =========================================================================
# Define the features to enable on board
#MACHINE_FEATURES += "bluetooth"
MACHINE_FEATURES += "wifi"
#MACHINE_FEATURES += "usbg0"

# Specific firmwares and kernel modules configuration
# =========================================================================
# Set the list of kernel module to be auto-loaded during boot
#KERNEL_MODULE_AUTOLOAD += ""

# Set Bluetooth related package list needed when 'bluetooth' feature is enabled
#BLUETOOTH_LIST += ""

# Set Wifi related package list needed when 'wifi' feature is enabled
#WIFI_LIST += ""

# CubeMX Project Config
# =========================================================================
# Assign CubeMX Board devicetree and project path name
CUBEMX_DTB = "stm32mp135f-thingscore-1-mx"
CUBEMX_PROJECT = "mx/thingscore-1"

# Indicate the size of DDR available on BOARD: 512 or 1024 (size in MB unit)
CUBEMX_BOARD_DDR_SIZE = "512"

# WIC image for EMMC full rootfs
WKS_FILE = "thingscore-emmc.wks"

# NAND UBI image tuned for 1GBit NAND
# WIKI: https://wiki.st.com/stm32mpu/wiki/How_to_add_a_new_parallel_or_serial_NAND_flash_memory_device_in_Yocto#Defining_EXTRA_UBIFS_SIZE_value
MKUBIFS_ARGS = "--min-io-size 2048 --leb-size 126976 --max-leb-cnt 880 --compr=lzo"
UBINIZE_ARGS = "--min-io-size 2048 --peb-size 128KiB"

MULTIUBI_BUILD    += "nand_2_128_256"

STM32MP_BOOTFS_SIZE = "20480"
STM32MP_ROOTFS_SIZE = "66560"
ST_VENDORFS = "0"
ST_USERFS = "0"

STM32MP_UBI_VOLUME:nand_2_128_256 = " \
    ${STM32MP_MULTIUBI_UENV1_LABEL}:${STM32MP_MULTIUBI_UENV1_SIZE}:empty \
    ${STM32MP_MULTIUBI_UENV2_LABEL}:${STM32MP_MULTIUBI_UENV2_SIZE}:empty \
    boot:${STM32MP_BOOTFS_SIZE}:ubifs \
    rootfs:${STM32MP_ROOTFS_SIZE}:ubifs:autoresize \
"
```

## wic/thingscore-emmc.wks
```
bootloader --ptable gpt

# Slots A and B for rootfs and bootfs partitions 
part /boot   --source bootimg-partition --ondisk mmcblk1 --fstype=ext4 --label bootfs_a   --fixed-size 64M --active
part /       --source rootfs            --ondisk mmcblk1 --fstype=ext4 --label rootfs_a --fixed-size 2048M --uuid e91c4e10-16e6-4c0e-bd0e-77becf4a3582
part /boot_b --source bootimg-partition --ondisk mmcblk1 --fstype=ext4 --label bootfs_b   --fixed-size 64M
part /       --source rootfs            --ondisk mmcblk1 --fstype=ext4 --label rootfs_b --fixed-size 2048M --uuid e91c4e10-16e6-4c0e-bd0e-77becf4a3582

# Userfs partition meant to be expanded to rest emmc
part /data   --ondisk mmcblk1 --fstype=ext4 --label userfs --size 256M
```
